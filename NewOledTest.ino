/**************************************************************************
 This is an example for our Monochrome OLEDs based on SSD1306 drivers

 Pick one up today in the adafruit shop!
 ------> http://www.adafruit.com/category/63_98

 This example is for a 128x32 pixel display using I2C to communicate
 3 pins are required to interface (two I2C and one reset).

 Adafruit invests time and resources providing this open
 source code, please support Adafruit and open-source
 hardware by purchasing products from Adafruit!

 Written by Limor Fried/Ladyada for Adafruit Industries,
 with contributions from the open source community.
 BSD license, check license.txt for more information
 All text above, and the splash screen below must be
 included in any redistribution.
 **************************************************************************/

#include <SPI.h>
#include <Wire.h>
#include <Adafruit_GFX.h>
#include <Adafruit_SSD1306.h>

#define SCREEN_WIDTH 128 // OLED display width, in pixels
#define SCREEN_HEIGHT 32 // OLED display height, in pixels

// Declaration for an SSD1306 display connected to I2C (SDA, SCL pins)
// The pins for I2C are defined by the Wire-library. 
// On an arduino UNO:       A4(SDA), A5(SCL)
// On an arduino MEGA 2560: 20(SDA), 21(SCL)
// On an arduino LEONARDO:   2(SDA),  3(SCL), ...
#define OLED_RESET     -1 // Reset pin # (or -1 if sharing Arduino reset pin)
#define SCREEN_ADDRESS 0x3C ///< See datasheet for Address; 0x3D for 128x64, 0x3C for 128x32
Adafruit_SSD1306 display(SCREEN_WIDTH, SCREEN_HEIGHT, &Wire, OLED_RESET);

#define NUMFLAKES     10 // Number of snowflakes in the animation example

#define LOGO_HEIGHT   32
#define LOGO_WIDTH    128
static const unsigned char PROGMEM logo_bmp[] =
{0x6a, 0x6e, 0xd4, 0x01, 0x8f, 0x0c, 0x1d, 0x0b, 0xef, 0x80, 0x42, 0x78, 0xe3, 0xc1, 0x08, 0x5f, 
 0x8a, 0x84, 0x9c, 0x07, 0x90, 0x92, 0x21, 0x0a, 0x02, 0x00, 0xa2, 0x85, 0x14, 0x22, 0x88, 0x50, 
  0x44, 0x44, 0xdc, 0x1d, 0x90, 0xa1, 0x41, 0x12, 0x02, 0x00, 0xa2, 0x85, 0x14, 0x22, 0x88, 0x90, 
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  0x00, 0x20, 0x00, 0x00, 0x00, 0x00, 0x00, 0x00, 0x00, 0x00, 0x00, 0x00, 0x00, 0x00, 0x00, 0x00};

static const unsigned char PROGMEM loading_screen[] = {
 0x07, 0xe0, 0x0f, 0xff, 0xdf, 0xff, 0xdf, 0xf8, 0x1f, 0xbf, 0xfe, 0x7d, 0xff, 0xf0, 0x00, 0x00, 
  0x07, 0xe0, 0x0f, 0xff, 0xdf, 0xff, 0xdf, 0xfe, 0x1f, 0xbf, 0xfe, 0x7d, 0xff, 0xf0, 0x00, 0x00, 
  0x07, 0xe0, 0x0f, 0xff, 0xdf, 0xff, 0xdf, 0xff, 0x1f, 0xbf, 0xfe, 0x7d, 0xff, 0xf0, 0x00, 0x00, 
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  0xff, 0xfd, 0xff, 0xfb, 0xe0, 0xfb, 0xff, 0x83, 0xf7, 0xe7, 0xff, 0xbf, 0xfc, 0x00, 0x00, 0x00
};

static const unsigned char PROGMEM sensorListText[] = {0x1b, 0xa4, 0x66, 0x3c, 0x22, 0x37, 0x00, 0x22, 0x34, 0x89, 0x44, 0x22, 0x42, 0x40, 0x44, 0x35, 
 0x09, 0x48, 0x22, 0x82, 0x00, 0x27, 0x58, 0x92, 0x70, 0x44, 0x42, 0x00, 0x14, 0x48, 0x52, 0x90, 
  0x44, 0x24, 0x80, 0xe7, 0x4b, 0x8c, 0x88, 0x74, 0xc4, 0x00
};

void setup() {
  Serial.begin(115200);

  // SSD1306_SWITCHCAPVCC = generate display voltage from 3.3V internally
  if(!display.begin(SSD1306_SWITCHCAPVCC, SCREEN_ADDRESS)) {
    Serial.println(F("SSD1306 allocation failed"));
    for(;;); // Don't proceed, loop forever
  }

  for(int i = 0; i < 8; i++){
    delay(50);
    if (i%3 == 0 || i%4 == 0){
      testdrawbitmap();
      display.display();
      delay(10);
    } else {
      display.clearDisplay();
      display.display();
      delay(10);
    }
  }
  
  testdrawbitmap();
  
  int initialx = 35;
  int x;
  int y = 20;
  for (int i = 0; i < 93; i += 3) {
    for (int j = 0; j < 1; j++) {
      x = initialx + j + i;
      //display.drawPixel(x + j + i - o, y + o, SSD1306_WHITE);
      display.drawLine(x, y, x - 5, y + 10, SSD1306_WHITE);
    }

    display.display();
    Serial.println(String(i) + "%");
    delay(50);

  }


  delay(700);
  display.clearDisplay();
  loadScreen();
  display.display();
  for (int a = 0; a < 5; a++){
    for(int i = 105; i <= 125; i+=5){
      loadDots(i);
      delay(200);
      display.display();
    }
    display.fillRect(105, 28, 128, 32, SSD1306_BLACK);
  }

  sensorList();
  display.display();

  /*
  display.setTextSize(2); // Draw 2X-scale text
  display.setTextColor(SSD1306_WHITE);
  display.setCursor(0, 0);
  display.println("load");
  display.display();
*/

}

void loop() {

}


void testdrawbitmap(void) {
  display.clearDisplay();

  display.drawBitmap(
    (display.width()  - LOGO_WIDTH ) / 2,
    (display.height() - LOGO_HEIGHT) / 2,
    logo_bmp, LOGO_WIDTH, LOGO_HEIGHT, 1);
  //display.display();
}

void loadScreen(void) {
  display.clearDisplay();

  display.drawBitmap(
    (display.width()  - LOGO_WIDTH ) / 2,
    (display.height() - LOGO_HEIGHT) / 2,
    loading_screen, LOGO_WIDTH, LOGO_HEIGHT, 1);
  //display.display();
}

void sensorList(void) {
  display.clearDisplay();

  display.drawBitmap(0, 0, sensorListText, 50, 8, 1);
  //display.display();
}

void loadDots(int i){

    
    /*display.drawPixel(i, 30, SSD1306_BLACK);
    display.drawPixel(i-1, 29, SSD1306_BLACK);
    display.drawPixel(i, 28, SSD1306_BLACK);
    display.drawPixel(i+1, 29, SSD1306_BLACK);
    */
    display.drawPixel(i+1, 30, SSD1306_WHITE);
    display.drawPixel(i, 29, SSD1306_WHITE);
    display.drawPixel(i+1, 28, SSD1306_WHITE);
    display.drawPixel(i+2, 29, SSD1306_WHITE);
}
